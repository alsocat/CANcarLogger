## firmware/main/Kconfig.projbuild
```kconfig
menu "OBD WiFi Bridge"
    config OBD_AP_SSID
        string "Access point SSID"
        default "OBD-ESP32"
    config OBD_AP_PASS
        string "Access point password (8+ chars)"
        default "changeme123"
    config OBD_STA_SSID
        string "Home WiFi SSID (leave empty to run as access point)"
        default ""
    config OBD_STA_PASS
        string "Home WiFi password"
        default ""
    config OBD_OTA_TOKEN
        string "Token required for OTA uploads (empty = no check)"
        default ""
    config OBD_SERVER_HOST
        string "carlog server host (.local names are resolved with mDNS)"
        default "carlog.local"
    config OBD_SERVER_PORT
        int "carlog server port"
        default 8080
    config OBD_SERVER_TOKEN
        string "Token sent to the carlog server"
        default ""
    config OBD_IPOD_USB
        bool "Feed boost to an iPod running Rockbox on the USB OTG port"
        default n
    config OBD_USB_VBUS_GPIO
        int "GPIO enabling the USB port's 5 V switch (-1 = none, always powered)"
        default -1
        depends on OBD_IPOD_USB
    config OBD_SLEEP
        bool "Deep sleep while the car is off (board on always-on OBD power)"
        default y
    config OBD_VBAT_GPIO
        int "GPIO with the battery voltage divider (ADC1: 1-10, -1 = none: wake on CAN only)"
        default -1
    config OBD_VBAT_RATIO_X1000
        int "Divider ratio x1000 (1 MOhm over 220 kOhm = 5545)"
        default 5545
    config OBD_WAKE_VOLTS_X10
        int "Battery volts x10 that mean the engine is running"
        default 130
    config OBD_SLEEP_CHECK_S
        int "Seconds between battery checks while asleep"
        default 20
endmenu
```

## firmware/sdkconfig.defaults
```kconfig
CONFIG_IDF_TARGET="esp32s3"
CONFIG_ESPTOOLPY_FLASHSIZE_16MB=y
# DevKitC-1: console on the UART (CH343) port
CONFIG_ESP_CONSOLE_UART_DEFAULT=y
CONFIG_ESP_CONSOLE_SECONDARY_NONE=y
CONFIG_LWIP_MAX_SOCKETS=16
CONFIG_PARTITION_TABLE_CUSTOM=y
CONFIG_PARTITION_TABLE_CUSTOM_FILENAME="partitions.csv"
CONFIG_BOOTLOADER_APP_ROLLBACK_ENABLE=y
CONFIG_BOOTLOADER_SKIP_VALIDATE_IN_DEEP_SLEEP=y
```
